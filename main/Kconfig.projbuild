## main/Kconfig.projbuild
```kconfig
menu "ESP-SDR board"

    config ESP_SDR_ATS_MINI
        bool "ATS-mini standalone spectrum display"
        depends on IDF_TARGET_ESP32S3
        default n
        help
            Enable the 320x170 parallel ST7789/GC9307 LCD and rotary encoder.
            Reception uses the ESP32-S3 RF backend. Keep the SI4732 radio and
            audio amplifier powered off; their antenna/audio path is not used.

    choice ESP_SDR_LILYGO_BOARD
        prompt "LILYGO standalone device"
        depends on IDF_TARGET_ESP32S3
        default ESP_SDR_LILYGO_NONE

        config ESP_SDR_LILYGO_NONE
            bool "None"
        config ESP_SDR_LILYGO_T_PAGER
            bool "T-LoRa Pager"
        config ESP_SDR_LILYGO_T_DISPLAY_S3_PRO
            bool "T-Display S3 Pro"
        config ESP_SDR_LILYGO_T_EMBED_SI4732
            bool "T-Embed SI4732"
        config ESP_SDR_LILYGO_T_EMBED_CC1101
            bool "T-Embed CC1101"
        config ESP_SDR_LILYGO_T_EMBED_CC1101_PLUS
            bool "T-Embed CC1101 Plus"
        config ESP_SDR_LILYGO_T_DECK
            bool "T-Deck / T-Deck Plus"
        config ESP_SDR_LILYGO_T_DECK_PRO
            bool "T-Deck Pro V1.0 (e-paper)"
        config ESP_SDR_LILYGO_T_DECK_PRO_V11
            bool "T-Deck Pro V1.1 (e-paper)"
    endchoice

    config ESP_SDR_LILYGO
        bool
        default y if ESP_SDR_LILYGO_T_PAGER || ESP_SDR_LILYGO_T_DISPLAY_S3_PRO || ESP_SDR_LILYGO_T_EMBED_SI4732 || ESP_SDR_LILYGO_T_EMBED_CC1101 || ESP_SDR_LILYGO_T_EMBED_CC1101_PLUS || ESP_SDR_LILYGO_T_DECK || ESP_SDR_LILYGO_T_DECK_PRO || ESP_SDR_LILYGO_T_DECK_PRO_V11
        help
            Uses the ESP32-S3 RF backend, onboard display and controls.
            External SI4732/CC1101/LoRa radios are not used for reception.

    choice ESP_SDR_M5STACK_BOARD
        prompt "M5Stack standalone device"
        depends on IDF_TARGET_ESP32 || IDF_TARGET_ESP32S3
        default ESP_SDR_M5STACK_NONE

        config ESP_SDR_M5STACK_NONE
            bool "None"
        config ESP_SDR_M5STACK_BASIC
            bool "M5Stack Basic"
            depends on IDF_TARGET_ESP32
            help
                Enable the Basic LCD and A/B/C buttons, mute its speaker and
                exclude onboard peripheral pins from the serial GPIO service.
                PC commands take priority over standalone controls.
        config ESP_SDR_M5STACK_CORE2
            bool "M5Stack Core2"
            depends on IDF_TARGET_ESP32
            help
                Enable the Core2 LCD, AXP192/AXP2101 power management and touch
                controls. PC commands take priority over standalone controls.
        config ESP_SDR_M5STACK_CARDPUTER
            bool "M5Stack Cardputer"
            depends on IDF_TARGET_ESP32S3
            help
                Enable the Cardputer ST7789 display and keyboard controls.
                Standalone FFT sizes up to 4096 points use internal RAM.
        config ESP_SDR_M5STACK_CARDPUTER_ADV
            bool "M5Stack Cardputer ADV"
            depends on IDF_TARGET_ESP32S3
            help
                Enable the Cardputer ADV ST7789 display and TCA8418 keyboard.
                Standalone FFT sizes up to 4096 points use internal RAM.
        config ESP_SDR_M5STACK_STICKC_PLUS2
            bool "M5StickC Plus2"
            depends on IDF_TARGET_ESP32
            help
                Enable the 135x240 ST7789 display and A/B/C buttons. Hold GPIO4
                high to keep the power rail enabled.
        config ESP_SDR_M5STACK_CORES3
            bool "CoreS3"
            depends on IDF_TARGET_ESP32S3
        config ESP_SDR_M5STACK_DIN_METER
            bool "DinMeter"
            depends on IDF_TARGET_ESP32S3
        config ESP_SDR_M5STACK_STICKS3
            bool "M5StickS3"
            depends on IDF_TARGET_ESP32S3
        config ESP_SDR_M5STACK_STICKC_PLUS
            bool "M5StickC Plus"
            depends on IDF_TARGET_ESP32
        config ESP_SDR_M5STACK_STICKC
            bool "M5StickC"
            depends on IDF_TARGET_ESP32
        config ESP_SDR_M5STACK_PAPER_COLOR
            bool "PaperColor"
            depends on IDF_TARGET_ESP32S3
        config ESP_SDR_M5STACK_PAPERS3
            bool "PaperS3"
            depends on IDF_TARGET_ESP32S3
    endchoice

    config ESP_SDR_M5STACK
        bool
        default y if ESP_SDR_M5STACK_BASIC
        default y if ESP_SDR_M5STACK_CORE2
        default y if ESP_SDR_M5STACK_CARDPUTER
        default y if ESP_SDR_M5STACK_CARDPUTER_ADV
        default y if ESP_SDR_M5STACK_STICKC_PLUS2
        default y if ESP_SDR_M5STACK_CORES3
        default y if ESP_SDR_M5STACK_DIN_METER
        default y if ESP_SDR_M5STACK_STICKS3
        default y if ESP_SDR_M5STACK_STICKC_PLUS
        default y if ESP_SDR_M5STACK_STICKC
        default y if ESP_SDR_M5STACK_PAPER_COLOR
        default y if ESP_SDR_M5STACK_PAPERS3

    config ESP_SDR_M5GFX_BOARD
        int
        default 1 if ESP_SDR_M5STACK_BASIC
        default 2 if ESP_SDR_M5STACK_CORE2
        default 14 if ESP_SDR_M5STACK_CARDPUTER
        default 24 if ESP_SDR_M5STACK_CARDPUTER_ADV
        default 5 if ESP_SDR_M5STACK_STICKC_PLUS2
        default 10 if ESP_SDR_M5STACK_CORES3
        default 13 if ESP_SDR_M5STACK_DIN_METER
        default 26 if ESP_SDR_M5STACK_STICKS3
        default 4 if ESP_SDR_M5STACK_STICKC_PLUS
        default 3 if ESP_SDR_M5STACK_STICKC
        default 28 if ESP_SDR_M5STACK_PAPER_COLOR
        default 19 if ESP_SDR_M5STACK_PAPERS3
        default 0

    config ESP_SDR_M5STACK_LCD_ILI9341
        bool "Early Basic with ILI9341 LCD"
        depends on ESP_SDR_M5STACK_BASIC
        default n
        help
            Select the ILI9341 panel on early Basic boards. Leave disabled
            for the ILI9342C panel used by newer Basic revisions.

endmenu

menu "ESP-SDR transport"

    config ESP_SDR_UART_ENABLED
        bool "Burst UART0 I/Q transport" if !IDF_TARGET_ESP32 && !IDF_TARGET_ESP32C2
        depends on IDF_TARGET_ESP32H2 || IDF_TARGET_ESP32C2 || IDF_TARGET_ESP32C5 || IDF_TARGET_ESP32C3 || IDF_TARGET_ESP32 || IDF_TARGET_ESP32S2 || IDF_TARGET_ESP32S3 || IDF_TARGET_ESP32C61 || IDF_TARGET_ESP32C6 || IDF_TARGET_ESP32S31
        default y
        help
            Enable the optional USB-to-UART bridge interface. Disable it to
            leave the UART GPIOs unused by the application. Native USB remains
            available on chips that support it. The original ESP32 and ESP32-C2 require UART.

    config ESP_SDR_UART_BAUD
        int "Burst UART0 I/Q baud rate"
        depends on IDF_TARGET_ESP32H2 || IDF_TARGET_ESP32C2 || IDF_TARGET_ESP32C5 || IDF_TARGET_ESP32C3 || IDF_TARGET_ESP32 || IDF_TARGET_ESP32S2 || IDF_TARGET_ESP32S3 || IDF_TARGET_ESP32C61 || IDF_TARGET_ESP32C6 || IDF_TARGET_ESP32S31
        range 115200 2500000 if IDF_TARGET_ESP32C2
        range 115200 3000000 if !IDF_TARGET_ESP32C2
        default 2000000
        help
            The burst I/Q protocol is also available on UART0, 8N1, without
            hardware flow control. The browser baud rate must match this value.
            BAUD 1000000 and BAUD 2000000 can change the running UART rate.
            Resetting the board restores this configured default.

    config ESP_SDR_UART_TX_PIN
        int "Burst UART0 TX GPIO"
        depends on IDF_TARGET_ESP32H2 || IDF_TARGET_ESP32C2 || IDF_TARGET_ESP32C5 || IDF_TARGET_ESP32C3 || IDF_TARGET_ESP32 || IDF_TARGET_ESP32S2 || IDF_TARGET_ESP32S3 || IDF_TARGET_ESP32C61 || IDF_TARGET_ESP32C6 || IDF_TARGET_ESP32S31
        range 0 20 if IDF_TARGET_ESP32C2
        range 0 27 if IDF_TARGET_ESP32H2
        range 0 48 if !IDF_TARGET_ESP32S31 && !IDF_TARGET_ESP32C2 && !IDF_TARGET_ESP32H2
        range 0 63 if IDF_TARGET_ESP32S31
        default 1 if IDF_TARGET_ESP32
        default 24 if IDF_TARGET_ESP32H2
        default 20 if IDF_TARGET_ESP32C2
        default 21 if IDF_TARGET_ESP32C3
        default 58 if IDF_TARGET_ESP32S31
        default 16 if IDF_TARGET_ESP32C6
        default 11 if IDF_TARGET_ESP32C61 || IDF_TARGET_ESP32C5
        default 43

    config ESP_SDR_UART_RX_PIN
        int "Burst UART0 RX GPIO"
        depends on IDF_TARGET_ESP32H2 || IDF_TARGET_ESP32C2 || IDF_TARGET_ESP32C5 || IDF_TARGET_ESP32C3 || IDF_TARGET_ESP32 || IDF_TARGET_ESP32S2 || IDF_TARGET_ESP32S3 || IDF_TARGET_ESP32C61 || IDF_TARGET_ESP32C6 || IDF_TARGET_ESP32S31
        range 0 20 if IDF_TARGET_ESP32C2
        range 0 27 if IDF_TARGET_ESP32H2
        range 0 48 if !IDF_TARGET_ESP32S31 && !IDF_TARGET_ESP32C2 && !IDF_TARGET_ESP32H2
        range 0 63 if IDF_TARGET_ESP32S31
        default 3 if IDF_TARGET_ESP32
        default 23 if IDF_TARGET_ESP32H2
        default 19 if IDF_TARGET_ESP32C2
        default 20 if IDF_TARGET_ESP32C3
        default 59 if IDF_TARGET_ESP32S31
        default 17 if IDF_TARGET_ESP32C6
        default 10 if IDF_TARGET_ESP32C61
        default 12 if IDF_TARGET_ESP32C5
        default 44

endmenu
```

## sdkconfig.defaults.lilygo-t-embed-cc1101
```kconfig
# LILYGO T-Embed CC1101 (16 MB, LCD/encoder, USB); internal SRAM, 4096-point local FFT.
CONFIG_IDF_TARGET="esp32s3"
CONFIG_ESP_SDR_LILYGO_T_EMBED_CC1101=y
CONFIG_ESPTOOLPY_FLASHMODE_QIO=y
CONFIG_ESPTOOLPY_FLASHFREQ_80M=y
CONFIG_ESPTOOLPY_FLASHSIZE_16MB=y
CONFIG_ESP_PHY_ENABLE_CERT_TEST=y
CONFIG_ESP_PHY_DEBUG=y
CONFIG_ESP_CONSOLE_USB_SERIAL_JTAG=y
CONFIG_ESP_CONSOLE_SECONDARY_NONE=y
CONFIG_ESP_MAIN_TASK_STACK_SIZE=8192
CONFIG_FREERTOS_HZ=1000
CONFIG_COMPILER_OPTIMIZATION_PERF=y
CONFIG_ESP_DEFAULT_CPU_FREQ_MHZ_240=y
CONFIG_DSP_MAX_FFT_SIZE_4096=y
CONFIG_DSP_MAX_FFT_SIZE=4096
# CONFIG_PM_ENABLE is not set
# CONFIG_ESP_WIFI_IRAM_OPT is not set
# CONFIG_ESP_WIFI_EXTRA_IRAM_OPT is not set
# CONFIG_ESP_WIFI_RX_IRAM_OPT is not set
# CONFIG_ESP_WIFI_SLP_IRAM_OPT is not set
# CONFIG_ESP_PHY_IRAM_OPT is not set
# CONFIG_ESP_WIFI_AMPDU_TX_ENABLED is not set
# CONFIG_ESP_WIFI_AMPDU_RX_ENABLED is not set
CONFIG_FREERTOS_UNICORE=y
# CONFIG_ESP_INT_WDT is not set
# CONFIG_ESP_TASK_WDT_EN is not set
CONFIG_ESP_WIFI_STATIC_RX_BUFFER_NUM=4
# Use native USB; GPIO43/44 may be connected to onboard peripherals.
# CONFIG_ESP_SDR_UART_ENABLED is not set
```

## sdkconfig.defaults.lilygo-t-watch-2020-v1
```kconfig
# LILYGO T-Watch 2020 V1 (16 MB, 240x240 LCD/touch, USB-UART).
CONFIG_IDF_TARGET="esp32"
CONFIG_ESP_SDR_LILYGO_T_WATCH_2020_V1=y
CONFIG_ESPTOOLPY_FLASHMODE_DIO=y
CONFIG_ESPTOOLPY_FLASHFREQ_40M=y
CONFIG_ESPTOOLPY_FLASHSIZE_16MB=y
CONFIG_XTAL_FREQ_40=y
CONFIG_ESP_PHY_ENABLE_CERT_TEST=y
CONFIG_ESP_PHY_DEBUG=y
CONFIG_ESP_CONSOLE_UART_DEFAULT=y
CONFIG_ESP_MAIN_TASK_STACK_SIZE=8192
CONFIG_FREERTOS_HZ=1000
CONFIG_COMPILER_OPTIMIZATION_PERF=y
CONFIG_ESP_DEFAULT_CPU_FREQ_MHZ_240=y
CONFIG_FREERTOS_UNICORE=y
CONFIG_DSP_MAX_FFT_SIZE_4096=y
CONFIG_DSP_MAX_FFT_SIZE=4096
# CONFIG_ESP_WIFI_IRAM_OPT is not set
# CONFIG_ESP_WIFI_RX_IRAM_OPT is not set
# CONFIG_ESP_PHY_IRAM_OPT is not set
# CONFIG_ESP_WIFI_AMPDU_TX_ENABLED is not set
# CONFIG_ESP_WIFI_AMPDU_RX_ENABLED is not set
CONFIG_ESP_SDR_UART_ENABLED=y
CONFIG_ESP_SDR_UART_BAUD=2000000
CONFIG_ESP_SDR_UART_TX_PIN=1
CONFIG_ESP_SDR_UART_RX_PIN=3

# Keep display history and density buffers out of internal SRAM.
CONFIG_SPIRAM=y
CONFIG_SPIRAM_SPEED_40M=y
CONFIG_SPIRAM_USE_CAPS_ALLOC=y
```

## sdkconfig.defaults.m5stack-core2
```kconfig
# M5Stack Core2 (AXP192 or AXP2101), 16 MB flash; no PSRAM required.
CONFIG_IDF_TARGET="esp32"
CONFIG_ESP_SDR_M5STACK_CORE2=y
CONFIG_ESPTOOLPY_FLASHMODE_DIO=y
CONFIG_ESPTOOLPY_FLASHFREQ_40M=y
CONFIG_ESPTOOLPY_FLASHSIZE_16MB=y
CONFIG_XTAL_FREQ_40=y
CONFIG_ESP_PHY_ENABLE_CERT_TEST=y
CONFIG_ESP_PHY_DEBUG=y
CONFIG_ESP_CONSOLE_UART_DEFAULT=y
CONFIG_ESP_MAIN_TASK_STACK_SIZE=8192
CONFIG_FREERTOS_HZ=1000
CONFIG_COMPILER_OPTIMIZATION_PERF=y
CONFIG_ESP_DEFAULT_CPU_FREQ_MHZ_240=y
CONFIG_FREERTOS_UNICORE=y
CONFIG_DSP_MAX_FFT_SIZE_4096=y
CONFIG_DSP_MAX_FFT_SIZE=4096
# CONFIG_SPIRAM is not set
# CONFIG_ESP_WIFI_IRAM_OPT is not set
# CONFIG_ESP_WIFI_RX_IRAM_OPT is not set
# CONFIG_ESP_PHY_IRAM_OPT is not set
# CONFIG_ESP_WIFI_AMPDU_TX_ENABLED is not set
# CONFIG_ESP_WIFI_AMPDU_RX_ENABLED is not set
CONFIG_ESP_SDR_UART_ENABLED=y
CONFIG_ESP_SDR_UART_BAUD=2000000
CONFIG_ESP_SDR_UART_TX_PIN=1
CONFIG_ESP_SDR_UART_RX_PIN=3
```

## sdkconfig.defaults.m5stack-din-meter
```kconfig
# M5Stack DinMeter (8 MB, LCD/encoder, USB); standalone ESP-SDR profile.
CONFIG_IDF_TARGET="esp32s3"
CONFIG_ESP_SDR_M5STACK_DIN_METER=y
CONFIG_ESPTOOLPY_FLASHMODE_QIO=y
CONFIG_ESPTOOLPY_FLASHFREQ_80M=y
CONFIG_ESPTOOLPY_FLASHSIZE_8MB=y
CONFIG_ESP_PHY_ENABLE_CERT_TEST=y
CONFIG_ESP_PHY_DEBUG=y
CONFIG_ESP_CONSOLE_USB_SERIAL_JTAG=y
CONFIG_ESP_CONSOLE_SECONDARY_NONE=y
CONFIG_ESP_MAIN_TASK_STACK_SIZE=8192
CONFIG_FREERTOS_HZ=1000
CONFIG_COMPILER_OPTIMIZATION_PERF=y
CONFIG_ESP_DEFAULT_CPU_FREQ_MHZ_240=y
CONFIG_DSP_MAX_FFT_SIZE_4096=y
CONFIG_DSP_MAX_FFT_SIZE=4096
# CONFIG_PM_ENABLE is not set
# CONFIG_ESP_WIFI_IRAM_OPT is not set
# CONFIG_ESP_WIFI_EXTRA_IRAM_OPT is not set
# CONFIG_ESP_WIFI_RX_IRAM_OPT is not set
# CONFIG_ESP_WIFI_SLP_IRAM_OPT is not set
# CONFIG_ESP_PHY_IRAM_OPT is not set
# CONFIG_ESP_WIFI_AMPDU_TX_ENABLED is not set
# CONFIG_ESP_WIFI_AMPDU_RX_ENABLED is not set
CONFIG_FREERTOS_UNICORE=y
# CONFIG_ESP_INT_WDT is not set
# CONFIG_ESP_TASK_WDT_EN is not set
CONFIG_ESP_WIFI_STATIC_RX_BUFFER_NUM=4
# Use native USB; reserve onboard peripheral pins.
# CONFIG_ESP_SDR_UART_ENABLED is not set
```

## sdkconfig.defaults.m5stack-paper-color
```kconfig
# M5Stack PaperColor (16 MB, color e-paper/buttons, USB); standalone ESP-SDR profile.
CONFIG_IDF_TARGET="esp32s3"
CONFIG_ESP_SDR_M5STACK_PAPER_COLOR=y
CONFIG_ESPTOOLPY_FLASHMODE_QIO=y
CONFIG_ESPTOOLPY_FLASHFREQ_80M=y
CONFIG_ESPTOOLPY_FLASHSIZE_16MB=y
CONFIG_ESP_PHY_ENABLE_CERT_TEST=y
CONFIG_ESP_PHY_DEBUG=y
CONFIG_ESP_CONSOLE_USB_SERIAL_JTAG=y
CONFIG_ESP_CONSOLE_SECONDARY_NONE=y
CONFIG_ESP_MAIN_TASK_STACK_SIZE=8192
CONFIG_FREERTOS_HZ=1000
CONFIG_COMPILER_OPTIMIZATION_PERF=y
CONFIG_ESP_DEFAULT_CPU_FREQ_MHZ_240=y
CONFIG_DSP_MAX_FFT_SIZE_4096=y
CONFIG_DSP_MAX_FFT_SIZE=4096
# CONFIG_PM_ENABLE is not set
# CONFIG_ESP_WIFI_IRAM_OPT is not set
# CONFIG_ESP_WIFI_EXTRA_IRAM_OPT is not set
# CONFIG_ESP_WIFI_RX_IRAM_OPT is not set
# CONFIG_ESP_WIFI_SLP_IRAM_OPT is not set
# CONFIG_ESP_PHY_IRAM_OPT is not set
# CONFIG_ESP_WIFI_AMPDU_TX_ENABLED is not set
# CONFIG_ESP_WIFI_AMPDU_RX_ENABLED is not set
CONFIG_FREERTOS_UNICORE=y
# CONFIG_ESP_INT_WDT is not set
# CONFIG_ESP_TASK_WDT_EN is not set
CONFIG_ESP_WIFI_STATIC_RX_BUFFER_NUM=4
# Use native USB; reserve onboard peripheral pins.
# CONFIG_ESP_SDR_UART_ENABLED is not set

# Keep display storage outside RF capture SRAM.
CONFIG_SPIRAM=y
CONFIG_SPIRAM_MODE_OCT=y
CONFIG_SPIRAM_SPEED_80M=y
CONFIG_SPIRAM_USE_CAPS_ALLOC=y
```

## sdkconfig.defaults.waveshare-amoled-206
```kconfig
# Waveshare ESP32-S3-Touch-AMOLED-2.06 (32 MB flash, 8 MB octal PSRAM).
CONFIG_IDF_TARGET="esp32s3"
CONFIG_ESP_SDR_WAVESHARE_AMOLED_206=y
CONFIG_ESPTOOLPY_FLASHMODE_QIO=y
CONFIG_ESPTOOLPY_FLASHFREQ_80M=y
CONFIG_ESPTOOLPY_FLASHSIZE_32MB=y
CONFIG_ESP_PHY_ENABLE_CERT_TEST=y
CONFIG_ESP_PHY_DEBUG=y
CONFIG_ESP_CONSOLE_USB_SERIAL_JTAG=y
CONFIG_ESP_CONSOLE_SECONDARY_NONE=y
CONFIG_ESP_MAIN_TASK_STACK_SIZE=8192
CONFIG_FREERTOS_HZ=1000
CONFIG_COMPILER_OPTIMIZATION_PERF=y
CONFIG_ESP_DEFAULT_CPU_FREQ_MHZ_240=y
CONFIG_DSP_MAX_FFT_SIZE_4096=y
CONFIG_DSP_MAX_FFT_SIZE=4096
# CONFIG_PM_ENABLE is not set
# CONFIG_ESP_WIFI_IRAM_OPT is not set
# CONFIG_ESP_WIFI_EXTRA_IRAM_OPT is not set
# CONFIG_ESP_WIFI_RX_IRAM_OPT is not set
# CONFIG_ESP_WIFI_SLP_IRAM_OPT is not set
# CONFIG_ESP_PHY_IRAM_OPT is not set
# CONFIG_ESP_WIFI_AMPDU_TX_ENABLED is not set
# CONFIG_ESP_WIFI_AMPDU_RX_ENABLED is not set
CONFIG_FREERTOS_UNICORE=y
# CONFIG_ESP_INT_WDT is not set
# CONFIG_ESP_TASK_WDT_EN is not set
CONFIG_ESP_WIFI_STATIC_RX_BUFFER_NUM=4

# Keep waterfall storage in the board's 8 MB octal PSRAM.
CONFIG_SPIRAM=y
CONFIG_SPIRAM_MODE_OCT=y
CONFIG_SPIRAM_SPEED_80M=y
CONFIG_SPIRAM_USE_CAPS_ALLOC=y
```
